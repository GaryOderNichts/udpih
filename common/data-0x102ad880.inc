0xba,0xbe,0x00,0x01,0x00,0x00,0x0c,0xb0,0x00,0x00,0x00,0x00,0x00,0x00,0x00,0x00,0xba,0xbe,0x00,0x02,0x00,0x00,0x0c,0xa0,0x10,0x2a,0xd8,0x80,0x00,0x00,0x00,0x00,
0x00,0x00,0x00,0x00,0x10,0x20,0x2f,0xa8,0x00,0x00,0x00,0x00,0x00,0x00,0x00,0x00,0x10,0x20,0x2f,0x20,0x10,0x29,0x9a,0x30,0x10,0x29,0x96,0xa0,0x00,0x00,0x00,0x00,
0x00,0x00,0x00,0x01,0x00,0x00,0x00,0x00,0x00,0x00,0x00,0x10,0x00,0x01,0x00,0x00,0x00,0x00,0x00,0x02,0x00,0x00,0x00,0x00,0x10,0x2a,0xf2,0x20,0x00,0x00,0x00,0x10,
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0x00,0x00,0x00,0x00,0x00,0x00,0x00,0x00,0x00,0x00,0x00,0x00,0x00,0x00,0x00,0x00,